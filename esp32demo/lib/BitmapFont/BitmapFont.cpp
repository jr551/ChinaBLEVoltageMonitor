#include "BitmapFont.h"

#include "ST7789.h"

namespace {
static const uint8_t kFont5x7[][5] PROGMEM = {
    {0x00,0x00,0x00,0x00,0x00},{0x00,0x00,0x5F,0x00,0x00},{0x00,0x07,0x00,0x07,0x00},
    {0x14,0x7F,0x14,0x7F,0x14},{0x24,0x2A,0x7F,0x2A,0x12},{0x23,0x13,0x08,0x64,0x62},
    {0x36,0x49,0x55,0x22,0x50},{0x00,0x05,0x03,0x00,0x00},{0x00,0x1C,0x22,0x41,0x00},
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    {0x00,0x41,0x36,0x08,0x00},{0x08,0x08,0x2A,0x1C,0x08},
};
}

namespace BitmapFont {

void drawChar(uint16_t x, uint16_t y, char c, uint16_t fg, uint16_t bg, uint8_t scale) {
    if (c < 32 || c > 126) {
        c = '?';
    }
    const uint8_t* glyph = kFont5x7[c - 32];
    for (uint8_t col = 0; col < 5; ++col) {
        uint8_t line = pgm_read_byte(&glyph[col]);
        for (uint8_t row = 0; row < 7; ++row) {
            uint16_t color = (line & (1 << row)) ? fg : bg;
            if (scale == 1) {
                LCD_DrawPixel(x + col, y + row, color);
            } else {
                LCD_FillRect(x + col * scale, y + row * scale, scale, scale, color);
            }
        }
    }

    for (uint8_t row = 0; row < 7; ++row) {
        if (scale == 1) {
            LCD_DrawPixel(x + 5, y + row, bg);
        } else {
            LCD_FillRect(x + 5 * scale, y + row * scale, scale, scale, bg);
        }
    }
}

void drawString(uint16_t x, uint16_t y, const String& text, uint16_t fg, uint16_t bg, uint8_t scale) {
    for (size_t i = 0; i < text.length(); ++i) {
        drawChar(x, y, text.charAt(i), fg, bg, scale);
        x += 6 * scale;
    }
}

void drawString(uint16_t x, uint16_t y, const char* text, uint16_t fg, uint16_t bg, uint8_t scale) {
    drawString(x, y, String(text), fg, bg, scale);
}

void drawStringCentered(uint16_t y, const String& text, uint16_t fg, uint16_t bg, uint8_t scale) {
    uint16_t width = textWidth(text, scale);
    uint16_t x = width < LCD_WIDTH ? (LCD_WIDTH - width) / 2 : 0;
    drawString(x, y, text, fg, bg, scale);
}

uint16_t textWidth(const String& text, uint8_t scale) {
    return text.length() * 6 * scale;
}

}  // namespace BitmapFont
